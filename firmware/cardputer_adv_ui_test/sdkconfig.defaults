## firmware/cardputer_adv_ui_test/sdkconfig.defaults
```kconfig
# Match the 2 MB flash chip used by the current Cardputer Adv PlatformIO setup.
CONFIG_ESPTOOLPY_FLASHSIZE_2MB=y
CONFIG_ESPTOOLPY_FLASHSIZE="2MB"

# The smoke app does not use TLS. Disabling the bundle keeps this PlatformIO
# ESP-IDF setup close to the known-good pocket_synth project.
# CONFIG_MBEDTLS_CERTIFICATE_BUNDLE is not set
```
